## src/nina/main/Kconfig.projbuild
```kconfig
menu "Streamer configuration"
    config USE_AS_AP
        bool "Act as access-point"
        default n
        help
            Act as accesspoint as opposed to connecting to a wifi

    menu "Credentials for connecting to another access-point"
        config EXAMPLE_SSID
            string "WiFi SSID"
            default "myssid"
            depends on !USE_AS_AP
            help
                SSID (network name) for the example to connect to.

        config EXAMPLE_PASSWORD
            string "WiFi Password"
            default "mypassword"
            depends on !USE_AS_AP
            help
                WiFi password (WPA or WPA2) for the example to use.
    endmenu

    config ENABLE_MDNS
        bool "Enable mDNS"
        default y
        help
            Allow NINA to be reached as hostname.local

    config MDNS_HOSTNAME
            string "mDNS Hostname"
            default "aideck"
            depends on ENABLE_MDNS
            help
                mDNS Hostname

    config ENABLE_UDP_TX
        bool "Use UDP for transmission (ESP->HOST)"
        default n
        help
            Reduce latency by transmitting CPX packets to host over UDP
endmenu
```
